## CMakeLists.txt
```
# SPDX-License-Identifier: Apache-2.0

cmake_minimum_required(VERSION 3.13.1)
find_package(Zephyr REQUIRED HINTS $ENV{ZEPHYR_BASE})
project(hdlc)

FILE(GLOB app_sources src/*.c)
target_sources(app PRIVATE ${app_sources})
```

## prj.conf
```kconfig
CONFIG_ZTEST=y
CONFIG_NETWORKING=y
CONFIG_NET_L2_HDLC=y

CONFIG_NO_OPTIMIZATIONS=y
```

## src/main.c
```c
/*
 * Copyright (c) 2020 Friedt Professional Engineering Services, Inc
 *
 * SPDX-License-Identifier: Apache-2.0
 */
#include <net/hdlc.h>

#include "hdlc_test.h"

#include <ztest.h>

/* context tests */
extern void test_init_16(void);
extern void test_init_32(void);

/* rx state tests */
extern void test_state_start_16(void);
extern void test_state_start_32(void);
extern void test_state_data_16(void);
extern void test_state_data_32(void);
extern void test_state_esc_16(void);
extern void test_state_esc_32(void);

/* rx tests */
extern void test_rx_forty_two_16(void);
extern void test_rx_forty_two_32(void);
extern void test_rx_hello_world_16(void);
extern void test_rx_hello_world_32(void);

/* tx tests */
extern void test_tx_forty_two_16(void);
extern void test_tx_forty_two_32(void);
extern void test_tx_hello_world_16(void);
extern void test_tx_hello_world_32(void);

void test_main(void)
{
	ztest_test_suite(test_hdlc,
		ztest_unit_test(test_init_16),
		ztest_unit_test(test_init_32),
		ztest_unit_test(test_state_start_16),
		ztest_unit_test(test_state_start_32),
		ztest_unit_test(test_state_data_16),
		ztest_unit_test(test_state_data_32),
		ztest_unit_test(test_state_esc_16),
		ztest_unit_test(test_state_esc_32),
		ztest_unit_test(test_rx_forty_two_16),
		ztest_unit_test(test_rx_forty_two_32),
		ztest_unit_test(test_rx_hello_world_16),
		ztest_unit_test(test_rx_hello_world_32),
		ztest_unit_test(test_tx_forty_two_16),
		ztest_unit_test(test_tx_forty_two_32),
		ztest_unit_test(test_tx_hello_world_16),
		ztest_unit_test(test_tx_hello_world_32));
	ztest_run_test_suite(test_hdlc);
}
```

## src/context.c
```c
/*
 * Copyright (c) 2020 Friedt Professional Engineering Services, Inc
 *
 * SPDX-License-Identifier: Apache-2.0
 */
#include <errno.h>

#include <net/hdlc.h>
#include <ztest.h>

#include "hdlc_test.h"

static void test_init_common(bool fcs32)
{
    struct hdlc_context ctx;
    uint32_t fcs_init;

    if (fcs32) {
	    get_ctx32(&ctx);
        /* Quirk in Zephyr's crc32 */
	    fcs_init = ~HDLC_FCS32_INIT;
    } else {
		get_ctx16(&ctx);
		fcs_init = HDLC_FCS16_INIT;
    }

    /* test declaration (happy path) */
    zassert_equal(true, hdlc_context_is_valid(&ctx), "declaration not valid");
    zassert_equal(0, ctx.frame_len, "wrong frame len");
    zassert_equal(fcs_init, ctx.fcs, "wrong init value");
    zassert_equal(HDLC_STATE_START, ctx.state, "wrong state");

    /* test initialization (happy path) */
    zassert_equal(0, hdlc_context_init(&ctx, fcs32, rx, &rx_buf, tx, &tx_buf, erase, &rx_buf), "initialization failed");
    zassert_equal(true, hdlc_context_is_valid(&ctx), "initialization not valid");
    zassert_equal(0, ctx.frame_len, "wrong frame len");
    zassert_equal(fcs_init, ctx.fcs, "wrong init value: exp: %x act: %x", fcs_init, ctx.fcs);
    zassert_equal(HDLC_STATE_START, ctx.state, "wrong state");

    /* test initialization (degenerate case) */
    zassert_equal(0, hdlc_context_init(&ctx, fcs32, NULL, NULL, NULL, NULL, NULL, NULL), "expected success");

    /* test invalid arguments */
    zassert_equal(-EINVAL, hdlc_context_init(NULL, fcs32, rx, &rx_buf, tx, &tx_buf, erase, &rx_buf), "expected -EINVAL");
    zassert_equal(-EINVAL, hdlc_context_init(&ctx, fcs32, NULL, &rx_buf, tx, &tx_buf, erase, &rx_buf), "expected -EINVAL");
    zassert_equal(-EINVAL, hdlc_context_init(&ctx, fcs32, rx, &rx_buf, NULL, &tx_buf, erase, &rx_buf), "expected -EINVAL");
    zassert_equal(-EINVAL, hdlc_context_init(&ctx, fcs32, rx, &rx_buf, tx, &tx_buf, NULL, &rx_buf), "expected -EINVAL");
}

/**  Check that initialization produces a valid 16-bit context */
void test_init_16(void)
{
    test_init_common(false);
}

/**  Check that initialization produces a valid 32-bit context */
void test_init_32(void)
{
    test_init_common(true);
}
```

## src/hdlc_test.h
```c
/*
 * Copyright (c) 2020 Friedt Professional Engineering Services, Inc
 *
 * SPDX-License-Identifier: Apache-2.0
 */

#ifndef HDLC_TEST_H_
#define HDLC_TEST_H_

#include <stdint.h>

#include <net/hdlc.h>

#define HELLO_WORLD_MSG "Hello, HDLC world!"

struct buf {
    uint8_t offs;
    uint8_t data[32];
};

int rx(void *arg, uint8_t byte);
int tx(void *arg, uint8_t byte);
int erase(void *arg, uint16_t n);

extern struct buf rx_buf;
extern struct buf tx_buf;

extern const uint8_t forty_two_frame_16[7];
extern const uint8_t forty_two_frame_32[9];

extern const uint8_t hello_world_frame_16[24];
extern const uint8_t hello_world_frame_32[26];

void get_ctx16(struct hdlc_context *ctx);
void get_ctx32(struct hdlc_context *ctx);

#endif /* HDLC_TEST_H_ */
```

## src/rx_forty_two.c
```c
#include <string.h>

#include <net/hdlc.h>
#include <sys/crc.h>
#include <sys/util.h>
#include <ztest.h>

#include "hdlc_test.h"

/** Test receiving a simple HDLC message */
void test_rx_forty_two_common(bool fcs32)
{
    /* Number of fcs bytes */
    const uint16_t m = 2;
    uint16_t n;
    const uint8_t *msg;
    struct hdlc_context ctx;

    if (fcs32) {
	    get_ctx32(&ctx);
        n = sizeof(forty_two_frame_32);
        msg = forty_two_frame_32;
    } else {
	    get_ctx16(&ctx);
        n = sizeof(forty_two_frame_16);
        msg = forty_two_frame_16;
    }

    /*
     * Assert that no reserved bytes exist in the message.
     * Otherwise, they would need to be escaped and we are being lazy here.
     */
    for (size_t i = 1; i < n - 1; ++i) {
	    zassert_false(hdlc_is_reserved(msg[i]), "found a reserved byte in the message");
    }

    /* process each byte escept the last flag */
    for (size_t i = 0; i < n - 1; ++i) {
	    zassert_equal(0, hdlc_process_byte(&ctx, msg[i]), "failed to process byte");
    }

    /* process the last flag. this should result in a finished frame */
    int r = hdlc_process_byte(&ctx, msg[n-1]);

    zassert_equal(r, n - m, "wrong message size: r: %d (n-m): %d", r, n - m);

    /* check the message contents are the same */
    zassert_equal(0, memcmp(rx_buf.data, &msg[1], n - m), "wrong message contents");
}

void test_rx_forty_two_16(void)
{
	return test_rx_forty_two_common(false);
}

void test_rx_forty_two_32(void)
{
	/* 0x04c11db7 */
	return test_rx_forty_two_common(true);
}
```

## src/rx_hello_world.c
```c
#include <string.h>

#include <net/hdlc.h>
#include <sys/crc.h>
#include <sys/util.h>
#include <ztest.h>

#include "hdlc_test.h"

/** Test receiving a simple HDLC message */
void test_rx_hello_world_common(bool fcs32)
{
    /* Number of fcs bytes */
    const uint16_t m = 2;
    uint16_t n;
    const uint8_t *msg;
    struct hdlc_context ctx;

    if (fcs32) {
	    get_ctx32(&ctx);
        n = sizeof(hello_world_frame_32);
        msg = hello_world_frame_32;
    } else {
	    get_ctx16(&ctx);
        n = sizeof(hello_world_frame_16);
        msg = hello_world_frame_16;
    }

    /*
     * Assert that no reserved bytes exist in the message.
     * Otherwise, they would need to be escaped and we are being lazy here.
     */
    for (size_t i = 1; i < n - 1; ++i) {
	    zassert_false(hdlc_is_reserved(msg[i]), "found a reserved byte in the message");
    }

    /* process each byte escept the last flag */
    for (size_t i = 0; i < n - 1; ++i) {
	    zassert_equal(0, hdlc_process_byte(&ctx, msg[i]), "failed to process byte");
    }

    /* process the last flag. this should result in a finished frame */
    int r = hdlc_process_byte(&ctx, msg[n-1]);

    zassert_equal(r, n - m, "wrong message size: r: %d (n-m): %d", r, n - m);

    /* check the message contents are the same */
    zassert_equal(0, memcmp(rx_buf.data, &msg[1], n - m), "wrong message contents");
}

void test_rx_hello_world_16(void)
{
	return test_rx_hello_world_common(false);
}

void test_rx_hello_world_32(void)
{
	return test_rx_hello_world_common(true);
}
```

## src/rx_state_data.c
```c
/*
 * Copyright (c) 2020 Friedt Professional Engineering Services, Inc
 *
 * SPDX-License-Identifier: Apache-2.0
 */
#include <errno.h>

#include <net/hdlc.h>
#include <sys/crc.h>
#include <ztest.h>

#include "hdlc_test.h"

static void test_state_data(bool fcs32)
{
	const uint8_t forty_two = 42;

    struct hdlc_context ctx;
    uint32_t fcs_init;

    if (fcs32) {
        fcs_init = ~HDLC_FCS32_INIT;
        get_ctx32(&ctx);
    } else {
        fcs_init = HDLC_FCS16_INIT;
        get_ctx16(&ctx);
    }

    /* state should be START */
    zassert_equal(ctx.state, HDLC_STATE_START, "wrong state");
    zassert_equal(ctx.frame_len, 0, "wrong length");
    zassert_equal(ctx.fcs, fcs_init, "wrong fcs");

    /* write 0x42 - since it is not a flag, state should remain the same */
    zassert_equal(0, hdlc_process_byte(&ctx, forty_two), "hdlc_process_byte() failed");
    zassert_equal(ctx.state, HDLC_STATE_START, "wrong state");
    zassert_equal(ctx.frame_len, 0, "wrong length");
    zassert_equal(ctx.fcs, fcs_init, "wrong fcs");
    /* erase() should have been called by reset() */
    zassert_equal(rx_buf.offs, 0, "wrong buffer offset");

    /* write flag, only the state should change to DATA */
    zassert_equal(0, hdlc_process_byte(&ctx, HDLC_FLAG), "hdlc_process_byte() failed");
    zassert_equal(ctx.state, HDLC_STATE_DATA, "wrong state");
    zassert_equal(ctx.frame_len, 0, "wrong length");
    zassert_equal(ctx.fcs, fcs_init, "wrong fcs");
    /* erase() should have been called by reset() */
    zassert_equal(rx_buf.offs, 0, "wrong buffer offset");

    /* hdlc_process_byte() returns an error if the underlying rx function fails.
     * Note: the goal here is tho show that it returns the application-specific error.
     * Depending on the receive buffer, this could be very different.
     */
    hdlc_context_reset(&ctx);
    zassert_equal(0, hdlc_process_byte(&ctx, HDLC_FLAG), "expected success");

    /* simulate a full buffer */
    rx_buf.offs = sizeof(rx_buf.data);
    ctx.frame_len = sizeof(rx_buf.data);
    zassert_equal(-ENOSPC, hdlc_process_byte(&ctx, 0x42), "expected -ENOSPC");
    zassert_equal(ctx.state, HDLC_STATE_START, "wrong state");
    zassert_equal(ctx.fcs, fcs_init, "wrong fcs");
    zassert_equal(ctx.frame_len, 0, "wrong length");
    /* erase() should have been called by reset() */
    zassert_equal(rx_buf.offs, 0, "wrong buffer offset: %u %u", rx_buf.offs, 0);
}

/** Test @ref HDLC_STATE_DATA for 16-bit */
void test_state_data_16(void)
{
    test_state_data(false);
}

/** Test @ref HDLC_STATE_DATA for 32-bit */
void test_state_data_32(void)
{
    test_state_data(true);
}
```

## src/rx_state_esc.c
```c
/*
 * Copyright (c) 2020 Friedt Professional Engineering Services, Inc
 *
 * SPDX-License-Identifier: Apache-2.0
 */
#include <errno.h>

#include <net/hdlc.h>
#include <sys/crc.h>
#include <ztest.h>

#include "hdlc_test.h"

static void test_state_esc(bool fcs32)
{
    const uint8_t forty_two = 0x42;
    struct hdlc_context ctx;
    struct hdlc_context pre;
    uint32_t fcs_init;

    if (fcs32) {
        fcs_init = ~HDLC_FCS32_INIT;
        get_ctx32(&ctx);
    } else {
        fcs_init = HDLC_FCS16_INIT;
    	get_ctx16(&ctx);
    }

    zassert_equal(0, hdlc_process_byte(&ctx, HDLC_FLAG), "expected success");
    zassert_equal(ctx.state, HDLC_STATE_DATA, "wrong state");

    /* write ESC */
    memcpy(&pre, &ctx, sizeof(pre));
    zassert_equal(0, hdlc_process_byte(&ctx, HDLC_ESC), "expected success");
    zassert_equal(ctx.state, HDLC_STATE_ESC, "wrong state");
    zassert_equal(ctx.frame_len, pre.frame_len, "wrong length");
    zassert_equal(ctx.fcs, pre.fcs, "wrong fcs");

    /* write FLAG ^ XOR */
    memcpy(&pre, &ctx, sizeof(pre));
    zassert_equal(0, hdlc_process_byte(&ctx, HDLC_FLAG ^ HDLC_XOR), "hdlc_process_byte() failed");
    zassert_equal(ctx.state, HDLC_STATE_DATA, "wrong state");
    zassert_equal(ctx.frame_len, pre.frame_len + 1, "wrong length");
    zassert_not_equal(ctx.fcs, pre.fcs, "wrong fcs");
    /* received data should be XOR'ed */
    zassert_equal(rx_buf.offs, 1, "wrong buffer length");
    zassert_equal(rx_buf.data[0], HDLC_FLAG, "wrong buffer value");

    hdlc_context_reset(&ctx);
    zassert_equal(0, hdlc_process_byte(&ctx, HDLC_FLAG), "expected success");
    zassert_equal(0, hdlc_process_byte(&ctx, HDLC_ESC), "expected success");
    zassert_equal(ctx.state, HDLC_STATE_ESC, "wrong state");

    /* write FLAG */
    memcpy(&pre, &ctx, sizeof(pre));
    zassert_equal(-EINVAL, hdlc_process_byte(&ctx, HDLC_FLAG), "expected -EINVAL");
    zassert_equal(ctx.state, HDLC_STATE_START, "wrong state");
    zassert_equal(ctx.fcs, fcs_init, "wrong fcs");
    zassert_equal(ctx.frame_len, 0, "wrong length");
    /* erase() should have been called by reset() */
    zassert_equal(rx_buf.offs, 0, "wrong buffer offset");

    hdlc_context_reset(&ctx);
    zassert_equal(0, hdlc_process_byte(&ctx, HDLC_FLAG), "expected success");
    zassert_equal(0, hdlc_process_byte(&ctx, HDLC_ESC), "expected success");

    /* escape arbitrary not-invalid byte while in ESC */
    memcpy(&pre, &ctx, sizeof(pre));
    zassert_equal(0, hdlc_process_byte(&ctx, forty_two), "expected success");
    zassert_equal(ctx.state, HDLC_STATE_DATA, "wrong state");
    zassert_not_equal(ctx.fcs, pre.fcs, "wrong fcs");
    zassert_equal(ctx.frame_len, pre.frame_len + 1, "wrong length");
    /* erase() should have been called by reset() */
    zassert_equal(rx_buf.offs, 1, "wrong buffer offset");

    /* hdlc_process_byte() returns an error if the underlying rx function fails.
     * Note: the goal here is tho show that it returns the application-specific error.
     * Depending on the receive buffer, this could be very different.
     */
    hdlc_context_reset(&ctx);
    zassert_equal(0, hdlc_process_byte(&ctx, HDLC_FLAG), "expected success");
    zassert_equal(0, hdlc_process_byte(&ctx, HDLC_ESC), "expected success");

    /* simulate a full buffer */
    rx_buf.offs = sizeof(rx_buf.data);
    ctx.frame_len = sizeof(rx_buf.data);
    zassert_equal(-ENOSPC, hdlc_process_byte(&ctx, 0x42), "expected -ENOSPC");
    zassert_equal(ctx.state, HDLC_STATE_START, "wrong state");
    zassert_equal(ctx.fcs, fcs_init, "wrong fcs");
    zassert_equal(ctx.frame_len, 0, "wrong length");
    /* erase() should have been called by reset() */
    zassert_equal(rx_buf.offs, 0, "wrong buffer offset");
}

/** Test @ref HDLC_STATE_ESC for 16-bit */
void test_state_esc_16(void)
{
    test_state_esc(false);
}

/** Test @ref HDLC_STATE_ESC for 32-bit */
void test_state_esc_32(void)
{
    test_state_esc(true);
}
```

## src/rx_state_start.c
```c
/*
 * Copyright (c) 2020 Friedt Professional Engineering Services, Inc
 *
 * SPDX-License-Identifier: Apache-2.0
 */
#include <errno.h>

#include <net/hdlc.h>
#include <ztest.h>

#include "hdlc_test.h"

static void test_state_start(bool fcs32)
{
    struct hdlc_context ctx;
    struct hdlc_context pre;
    uint32_t fcs_init;

    if (fcs32) {
        /* Quirk in crc32_ieee_update() */
	    fcs_init = ~HDLC_FCS32_INIT;
	    get_ctx32(&ctx);
    } else {
		fcs_init = HDLC_FCS16_INIT;
        get_ctx16(&ctx);
    }

    /* state should be the same */
    zassert_equal(ctx.fcs, fcs_init, "wrong initial fcs");
    zassert_equal(ctx.state, HDLC_STATE_START, "wrong initial state");
    zassert_equal(ctx.frame_len, 0, "wrong initial length");

    /* write a non-HDLC_FLAG byte that should be discarded */
    memcpy(&pre, &ctx, sizeof(pre));
    zassert_equal(0, hdlc_process_byte(&ctx, 0x42), "hdlc_process_byte() failed");

    /* fcs should be the same */
    zassert_equal(ctx.fcs, pre.fcs, "wrong fcs");
    zassert_equal(ctx.state, HDLC_STATE_START, "wrong state");
    zassert_equal(ctx.frame_len, pre.frame_len, "wrong length");
    zassert_equal(rx_buf.offs, 0, "wrong buffer offset: %u %u", rx_buf.offs, 0);

    /* write a reserved HDLC byte that should be discarded */
    hdlc_process_byte(&ctx, HDLC_ESC);

    /* state should be the same */
    zassert_equal(ctx.fcs, pre.fcs, "wrong fcs");
    zassert_equal(ctx.state, HDLC_STATE_START, "wrong state");
    zassert_equal(ctx.frame_len, pre.frame_len, "wrong length");
    zassert_equal(rx_buf.offs, 0, "wrong buffer offset: %u %u", rx_buf.offs, 0);

    /* write a HDLC_FLAG byte that should be discarded, but state should change */
    zassert_equal(0, hdlc_process_byte(&ctx, HDLC_FLAG), "hdlc_process_byte() failed");
    zassert_equal(ctx.fcs, pre.fcs, "wrong fcs: %08x %08x", ctx.fcs, pre.fcs);
    zassert_equal(ctx.state, HDLC_STATE_DATA, "wrong state");
    zassert_equal(ctx.frame_len, pre.frame_len, "wrong length");
    zassert_equal(rx_buf.offs, 0, "wrong buffer offset: %u %u", rx_buf.offs, 0);
}

/** Test @ref HDLC_STATE_START for 16-bit */
void test_state_start_16(void)
{
    test_state_start(false);
}

/** Test @ref HDLC_STATE_START for 32-bit */
void test_state_start_32(void)
{
    test_state_start(true);
}
```

## src/support.c
```c
#include <errno.h>
#include <stdint.h>
#include <string.h>

#include <sys/crc.h>
#include <ztest.h>

#include "hdlc_test.h"

#define FLAGSTR "\x7e"

BUILD_ASSERT(0x7e == HDLC_FLAG, "FLAGSTR and HDLC_FLAG are inconsistent");

/* buffers */
struct buf rx_buf;
struct buf tx_buf;

/* These buffers were created using the sample code in sections
 * C.2 and C.3 of RFC 1662
 */
const uint8_t forty_two_frame_16[7] =
    /* clang-format off */
    FLAGSTR
    "\x01" /* addr */
    "\x03" /* ctrl */
    "\x42" /* forty-two */
    "\x6e" /* LSB of FCS-16 */
    "\xd7" /* LSB of FCS-16 */
    FLAGSTR
    /* clang-format on */
    ;

const uint8_t forty_two_frame_32[9] =
    /* clang-format off */
    FLAGSTR
    "\x01" /* addr */
    "\x03" /* ctrl */
    "\x42" /* forty-two */
    "\x5a" /* LSB of FCS-32 */
    "\xc0" /* 2nd LSB of FCS-32 */
    "\x7c" /* 2nd MSB of FCS-32 */
    "\x4d" /* MSB of FCS-32 */
    FLAGSTR
    /* clang-format on */
    ;

const uint8_t hello_world_frame_16[24] =
    /* clang-format off */
    FLAGSTR
    "\x01" /* addr */
    "\x03" /* ctrl */
    HELLO_WORLD_MSG
    "\x9e" /* LSB of FCS-16 */
    "\x50" /* LSB of FCS-16 */
    FLAGSTR
    /* clang-format on */
    ;

const uint8_t hello_world_frame_32[26] =
    /* clang-format off */
    FLAGSTR
    "\x01" /* addr */
    "\x03" /* ctrl */
    HELLO_WORLD_MSG
    "\x57" /* LSB of FCS-32 */
    "\x89" /* 2nd LSB of FCS-32 */
    "\xf2" /* 2nd MSB of FCS-32 */
    "\xfa" /* MSB of FCS-32 */
    FLAGSTR
    /* clang-format on */
    ;

/* contexts */
static void get_ctx(struct hdlc_context *ctx, bool fcs32)
{
	DECLARE_HDLC_CONTEXT(tmp, fcs32, rx, &rx_buf, tx, &tx_buf, erase, &rx_buf);

	memset(&rx_buf, 0, sizeof(rx_buf));
	memset(&tx_buf, 0, sizeof(tx_buf));
    memcpy(ctx, &tmp, sizeof(tmp));
}

void get_ctx16(struct hdlc_context *ctx)
{
    get_ctx(ctx, false);
}

void get_ctx32(struct hdlc_context *ctx)
{
    get_ctx(ctx, true);
}

/* callbacks for contexts */
int rx(void *arg, uint8_t byte)
{
    struct buf *buf;

    zassert_equal(&rx_buf, arg, "expected: %p actual: %p", &rx_buf, arg);
    buf = (struct buf *)arg;

    if (buf->offs >= sizeof(buf->data)) {
	    return -ENOSPC;
    }

    buf->data[buf->offs++] = byte;

    return 0;
}

int tx(void *arg, uint8_t byte)
{
    struct buf *buf;

    zassert_equal(&tx_buf, arg, "expected: %p actual: %p", &tx_buf, arg);
    buf = (struct buf *)arg;

    if (buf->offs >= sizeof(buf->data)) {
	return -ENOSPC;
    }

    buf->data[buf->offs++] = byte;
    return 0;
}

int erase(void *arg, uint16_t n)
{
    struct buf *buf;

    zassert_equal(&rx_buf, arg, "expected: %p actual: %p", &rx_buf, arg);
    buf = (struct buf *)arg;

    if (n > buf->offs) {
	    return -E2BIG;
    }

    buf->offs -= n;
    return 0;
}
```

## src/tx_forty_two.c
```c
#include <net/hdlc.h>

#include <ztest.h>

#include "hdlc_test.h"

#define LOG_LEVEL LOG_LEVEL_DBG
#include <logging/log.h>
LOG_MODULE_REGISTER(test_net_hdlc);

void test_tx_forty_two_common(bool fcs32)
{
    const uint8_t addr = 1;
    const uint8_t ctrl = 3;
    const uint8_t forty_two = 0x42;
    const uint8_t *forty_two_frame;
    uint16_t n;

    struct hdlc_context ctx;
    if (fcs32) {
        get_ctx32(&ctx);
        forty_two_frame = forty_two_frame_32;
        n = sizeof(forty_two_frame_32);
    } else {
        get_ctx16(&ctx);
        forty_two_frame = forty_two_frame_16;
        n = sizeof(forty_two_frame_16);
    }

    zassert_equal(0, hdlc_write(&ctx, &addr, 1, &ctrl, 1, &forty_two, 1), "expected success");
    zassert_equal(tx_buf.offs, n, "wrong size:P %u %u", tx_buf.offs, n);
    zassert_equal(0, memcmp(tx_buf.data, forty_two_frame, n), "wrong data");
}

void test_tx_forty_two_16(void)
{
    test_tx_forty_two_common(false);
}

void test_tx_forty_two_32(void)
{
    test_tx_forty_two_common(true);
}
```

## src/tx_hello_world.c
```c
#include <net/hdlc.h>

#include <ztest.h>

#include "hdlc_test.h"

void test_tx_hello_world_common(bool fcs32)
{
    const uint8_t addr = 1;
    const uint8_t ctrl = 3;
    const uint8_t *hello_world = HELLO_WORLD_MSG;
    uint16_t len = strlen(hello_world);
    const uint8_t *hello_world_frame;
    uint16_t n;

    struct hdlc_context ctx;
    if (fcs32) {
        get_ctx32(&ctx);
        hello_world_frame = hello_world_frame_32;
        n = sizeof(hello_world_frame_32);
    } else {
        get_ctx16(&ctx);
        hello_world_frame = hello_world_frame_16;
        n = sizeof(hello_world_frame_16);
    }

    zassert_equal(0, hdlc_write(&ctx, &addr, 1, &ctrl, 1, hello_world, len), "expected success");
    zassert_equal(tx_buf.offs, n, "wrong size");
    zassert_equal(0, memcmp(tx_buf.data, hello_world_frame, n), "wrong data");
}

void test_tx_hello_world_16(void)
{
    test_tx_hello_world_common(false);
}

void test_tx_hello_world_32(void)
{
    test_tx_hello_world_common(true);
}
```

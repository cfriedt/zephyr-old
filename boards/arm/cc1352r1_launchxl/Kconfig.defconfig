## boards/arm/cc1352r1_launchxl/Kconfig.defconfig
```kconfig
# TI CC1352R LaunchXL board

# Copyright (c) 2019 Brett Witherspoon
# SPDX-License-Identifier: Apache-2.0

if BOARD_CC1352R1_LAUNCHXL

config BOARD
	default "cc1352r1_launchxl"

if SPI

config SPI_0
	default y

endif # SPI

if BT

config BT_CTLR
	default y
	select BLE_VENDOR_LLL_TI
	select BLE_CC13XX_CC26XX
	select ENTROPY_CC13XX_CC26XX_RNG

# To debug the BLE radio using GPIO, uncomment the line below
# See the file subsys/bluetooth/controller/ll_sw/ti/hal/cc13xx_cc26xx/debug.h
# for details
	select BT_CTLR_DEBUG_PINS

endif # BT

endif # BOARD_CC1352R1_LAUNCHXL
```

## dts/bindings/usb/zephyr,usb-dc-emu.yaml
```yaml
# Copyright (c) 2020 Friedt Professional Engineering Services, Inc
# SPDX-License-Identifier: Apache-2.0

description: Emulated USB Device Controller 

compatible: "zephyr,usb-dc-emu"

include: usb-ep.yaml

properties:
  label:
    type: string
    required: true

  xport-type:
    type: int
    required: true

  xport-dev:
    type: phandle
    required: true
```

## subsys/net/l2/hdlc/Kconfig
```kconfig
# Copyright (c) 2016 Intel Corporation
# SPDX-License-Identifier: Apache-2.0

config NET_L2_HDLC
	bool "High-Level Data Link Control"
	help
	  This option enables support for the HDLC Layer 2 protocol
	  which is used by PPP and others.
```

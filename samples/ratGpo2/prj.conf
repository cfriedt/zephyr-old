## CMakeLists.txt
```
# SPDX-License-Identifier: Apache-2.0

cmake_minimum_required(VERSION 3.13.1)

include($ENV{ZEPHYR_BASE}/cmake/app/boilerplate.cmake NO_POLICY_SCOPE)
project(rfPacketErrorRate)

zephyr_include_directories(
	src
)

target_sources(app PRIVATE
	src/main.c
	src/power.c
	src/smartrf_settings.c
	src/ti/drivers/pin/PINCC26XX.c
)
```

## prj.conf
```kconfig
CONFIG_BT_DEBUG_A2DP=y
CONFIG_BT_DEBUG_ATT=y
CONFIG_BT_DEBUG_AVDTP=y
CONFIG_BT_DEBUG_CONN=y
CONFIG_BT_DEBUG_GATT=y
CONFIG_BT_DEBUG_HCI_CORE=y
CONFIG_BT_DEBUG_HCI_DRIVER=y
CONFIG_BT_DEBUG_HFP_HF=y
CONFIG_BT_DEBUG_KEYS=y
CONFIG_BT_DEBUG_L2CAP=y
CONFIG_BT_DEBUG_LOG=y
CONFIG_BT_DEBUG_RFCOMM=y
CONFIG_BT_DEBUG_RPA=y
CONFIG_BT_DEBUG_SDP=y
CONFIG_BT_DEBUG_SERVICE=y
CONFIG_BT_DEBUG_SETTINGS=y
CONFIG_BT_DEBUG_SMP=y

CONFIG_UART_CC13XX_CC26XX_0=y
CONFIG_CONSOLE_SUBSYS=y
CONFIG_SIMPLELINK_HOST_DRIVER=y
CONFIG_HAS_CC13X2_CC26X2_SDK=y
CONFIG_SOC_CC1352R=y

CONFIG_NO_OPTIMIZATIONS=y
```

## src/main.c
```c
#define DeviceFamily_CC13X2
#include <ti/drivers/rf/RF.h>
#include <ti/drivers/PIN.h>
#include <ti/drivers/pin/PINCC26XX.h>
#include <driverlib/ioc.h>

#include "smartrf_settings.h"

static RF_Object rfObject;
static RF_Handle rfHandle;
static RF_RatHandle ratHandle;
static RF_RatConfigCompare config;
static RF_RatConfigOutput output;

/* Pin driver handle */
static PIN_Handle ledPinHandle;
static PIN_State ledPinState;

PIN_Config pinTable[] =
{
    IOID_24 | PIN_GPIO_OUTPUT_EN | PIN_GPIO_LOW | PIN_PUSHPULL | PIN_DRVSTR_MAX,
    PIN_TERMINATE
};

#define D(fmt, args...) printk( fmt "\n", ##args )

static void describe_rf_event( const RF_EventMask e ) {

	if ( e & RF_EventCmdDone ) D( "A radio operation command in a chain finished.");
	if ( e & RF_EventLastCmdDone ) D( "The last radio operation command in a chain finished.");
	if ( e & RF_EventFGCmdDone ) D( "A IEEE-mode radio operation command in a chain finished.");
	if ( e & RF_EventLastFGCmdDone ) D( "A stand-alone IEEE-mode radio operation command or the last command in a chain finished.");
	if ( e & RF_EventTxDone ) D( "Packet transmitted");
	if ( e & RF_EventTXAck ) D( "ACK packet transmitted");
	if ( e & RF_EventTxCtrl ) D( "Control packet transmitted");
	if ( e & RF_EventTxCtrlAck ) D( "Acknowledgement received on a transmitted control packet");
	if ( e & RF_EventTxCtrlAckAck ) D( "Acknowledgement received on a transmitted control packet, and acknowledgement transmitted for that packet");
	if ( e & RF_EventTxRetrans ) D( "Packet retransmitted");
	if ( e & RF_EventTxEntryDone ) D( "Tx queue data entry state changed to Finished");
	if ( e & RF_EventTxBufferChange ) D( "A buffer change is complete");
	if ( e & RF_EventPaChanged ) D( "The PA was reconfigured on the fly.");
	if ( e & RF_EventRxOk ) D( "Packet received with CRC OK, payload, and not to be ignored");
	if ( e & RF_EventRxNOk ) D( "Packet received with CRC error");
	if ( e & RF_EventRxIgnored ) D( "Packet received with CRC OK, but to be ignored");
	if ( e & RF_EventRxEmpty ) D( "Packet received with CRC OK, not to be ignored, no payload");
	if ( e & RF_EventRxCtrl ) D( "Control packet received with CRC OK, not to be ignored");
	if ( e & RF_EventRxCtrlAck ) D( "Control packet received with CRC OK, not to be ignored, then ACK sent");
	if ( e & RF_EventRxBufFull ) D( "Packet received that did not fit in the Rx queue");
	if ( e & RF_EventRxEntryDone ) D( "Rx queue data entry changing state to Finished");
	if ( e & RF_EventDataWritten ) D( "Data written to partial read Rx buffer");
	if ( e & RF_EventNDataWritten ) D( "Specified number of bytes written to partial read Rx buffer");
	if ( e & RF_EventRxAborted ) D( "Packet reception stopped before packet was done");
	if ( e & RF_EventRxCollisionDetected ) D( "A collision was indicated during packet reception");
	if ( e & RF_EventModulesUnlocked ) D( "As part of the boot process, the CM0 has opened access to RF core modules and memories");
	if ( e & RF_EventInternalError ) D( "Internal error observed");
	if ( e & RF_EventMdmSoft ) D( "Synchronization word detected (MDMSOFT interrupt flag)");
	if ( e & RF_EventCmdCancelled ) D( "Command canceled before it was started.");
	if ( e & RF_EventCmdAborted ) D( "Abrupt command termination caused by RF_cancelCmd() or RF_flushCmd().");
	if ( e & RF_EventCmdStopped ) D( "Graceful command termination caused by RF_cancelCmd() or RF_flushCmd().");
	if ( e & RF_EventRatCh ) D( "A user-programmable RAT channel triggered an event.");
	//if ( e & RF_EventPowerUp ) D( "RF power up event. deprecated This event is deprecated. Use RF_ClientEventPowerUpFinished instead.");
	if ( e & RF_EventError ) D( "Event flag used for error callback functions to indicate an error. See RF_Params::pErrCb.");
	if ( e & RF_EventCmdPreempted ) D( "Command preempted by another command with higher priority. Applies only to multi-client applications.");

}

void onRatTriggered(RF_Handle h, RF_RatHandle rh, RF_EventMask e, uint32_t compareCaptureTime)
{
    describe_rf_event( e );
    if (e & RF_EventError)
    {
        while(1);
    }
    else
    {
        // Trigger precisely with the same period again
        config.timeout = compareCaptureTime + RF_convertMsToRatTicks(5);
        ratHandle = RF_ratCompare(rfHandle, &config, &output);
    }
}

const PINCC26XX_HWAttrs PINCC26XX_hwAttrs = {
    .intPriority = ~0,
    .swiPriority = 0
};

int main(int argc, char **argv)
{
	(void)argc;
	(void)argv;

	PIN_Status ps = PIN_init(pinTable);
	if (PIN_SUCCESS != ps) {
		while(1);
	}

    RF_Params rfParams;
    RF_Params_init(&rfParams);

    /* Open LED pins */
    ledPinHandle = PIN_open(&ledPinState, pinTable);
    if (ledPinHandle == NULL)
    {
        while(1);
    }

    PINCC26XX_setMux(ledPinHandle, IOID_24, PINCC26XX_MUX_RFC_GPO2);
    rfHandle = RF_open(&rfObject, &RF_prop, (RF_RadioSetup*)&RF_cmdPropRadioDivSetup, &rfParams);

    RF_RatConfigOutput_init(&output);
    output.mode = RF_RatOutputModeToggle;
    output.select = RF_RatOutputSelectRatGpo2;

    RF_RatConfigCompare_init(&config);
    config.callback = &onRatTriggered;
    config.channel = RF_RatChannel2;
    config.timeout = RF_getCurrentTime() + RF_convertMsToRatTicks(5);
    ratHandle = RF_ratCompare(rfHandle, &config, &output);

    while(1);
}
```

## src/smartrf_settings.c
```c
#include "smartrf_settings.h"

// TI-RTOS RF Mode Object
RF_Mode RF_prop =
{
    .rfMode = RF_MODE_AUTO,
    .cpePatchFxn = &rf_patch_cpe_multi_protocol, //&rf_patch_cpe_prop,
    .mcePatchFxn = 0,
    .rfePatchFxn = 0,
};

// Overrides for CMD_PROP_RADIO_DIV_SETUP
uint32_t pOverrides[] =
{
	HW_REG_OVERRIDE(0x1110, RFC_DBELL_SYSGPOCTL_GPOCTL2_RATGPO2),
    // override_prop_common.xml
    // DC/DC regulator: In Tx, use DCDCCTL5[3:0]=0x7 (DITHER_EN=0 and IPEAK=7).
    (uint32_t)0x00F788D3,
    // override_tc106.xml
    // Tx: Configure PA ramp time, PACTL2.RC=0x3 (in ADI0, set PACTL2[4:3]=0x3)
    ADI_2HALFREG_OVERRIDE(0,16,0x8,0x8,17,0x1,0x1),
    // Rx: Set AGC reference level to 0x1A (default: 0x2E)
    HW_REG_OVERRIDE(0x609C,0x001A),
    // Rx: Set RSSI offset to adjust reported RSSI by -1 dB (default: -2), trimmed for external bias and differential configuration
    (uint32_t)0x000188A3,
    // Rx: Set anti-aliasing filter bandwidth to 0xD (in ADI0, set IFAMPCTL3[7:4]=0xD)
    ADI_HALFREG_OVERRIDE(0,61,0xF,0xD),
    // Tx: Set wait time before turning off ramp to 0x1A (default: 0x1F)
    HW_REG_OVERRIDE(0x6028,0x001A),
#if (CCFG_FORCE_VDDR_HH)
    // TX power override
    // Tx: Set PA trim to max to maximize its output power (in ADI0, set PACTL0=0xF8)
    ADI_REG_OVERRIDE(0,12,0xF8),
#endif
    (uint32_t)0xFFFFFFFF,
};
rfc_CMD_PROP_RADIO_DIV_SETUP_t RF_cmdPropRadioDivSetup =
{
    .commandNo = 0x3807,
    .status = 0x0000,
    .pNextOp = 0, // INSERT APPLICABLE POINTER: (uint8_t*)&xxx
    .startTime = 0x00000000,
    .startTrigger.triggerType = 0x0,
    .startTrigger.bEnaCmd = 0x0,
    .startTrigger.triggerNo = 0x0,
    .startTrigger.pastTrig = 0x0,
    .condition.rule = 0x1,
    .condition.nSkip = 0x0,
    .modulation.modType = 0x1,
    .modulation.deviation = 0x64,
    .modulation.deviationStepSz = 0x0,
    .symbolRate.preScale = 0xF,
    .symbolRate.rateWord = 0x8000,
    .symbolRate.decimMode = 0x0,
    .rxBw = 0x52,
    .preamConf.nPreamBytes = 0x4,
    .preamConf.preamMode = 0x0,
    .formatConf.nSwBits = 0x20,
    .formatConf.bBitReversal = 0x0,
    .formatConf.bMsbFirst = 0x1,
    .formatConf.fecMode = 0x0,
    .formatConf.whitenMode = 0x0,
    .config.frontEndMode = 0x0,
    .config.biasMode = 0x1,
    .config.analogCfgMode = 0x0,
    .config.bNoFsPowerUp = 0x0,
    .txPower = 0x013F,
    .pRegOverride = pOverrides,
    .centerFreq = 0x0364,
    .intFreq = 0x8000,
    .loDivider = 0x05,
};
```

## src/smartrf_settings.h
```c
#ifndef SMARTRF_SETTINGS_H_
#define SMARTRF_SETTINGS_H_

#define DeviceFamily_CC13X2
#include <ti/devices/DeviceFamily.h>
#include DeviceFamily_constructPath(driverlib/rf_mailbox.h)
#include DeviceFamily_constructPath(driverlib/rf_common_cmd.h)
#include DeviceFamily_constructPath(driverlib/rf_prop_cmd.h)
#include <ti/drivers/rf/RF.h>
#include DeviceFamily_constructPath(rf_patches/rf_patch_cpe_multi_protocol.h)

#include <inc/hw_rfc_dbell.h>

extern RF_Mode RF_prop;
extern rfc_CMD_PROP_RADIO_DIV_SETUP_t RF_cmdPropRadioDivSetup;

#endif /* SMARTRF_SETTINGS_H_ */
```
